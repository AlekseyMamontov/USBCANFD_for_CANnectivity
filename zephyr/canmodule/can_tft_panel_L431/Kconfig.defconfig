## zephyr/canmodule/can_tft_panel_L431/board.yml
```yaml
# Copyright (c) 2026 Oleksii Mamontov <mamontov1@gmail.com>
# SPDX-License-Identifier: Apache-2.0

board:
  name: can_tft_panel_L431
  full_name: CAN TFT Panel L431
  vendor: canmodule
  socs:
    - name: stm32l431xx
```

## zephyr/canmodule/can_tft_panel_L431/can_tft_panel_L431_defconfig
```kconfig
# Copyright (c) 2026 Oleksii Mamontov <mamontov1@gmail.com>
# SPDX-License-Identifier: Apache-2.0

# Enable MPU
CONFIG_ARM_MPU=y

# Enable HW stack protection
CONFIG_HW_STACK_PROTECTION=y

# enable GPIO
CONFIG_GPIO=y
```

## zephyr/canmodule/canbridge_g473_can_module/board.yml
```yaml
board:
  name: canbridge_g473_can_module
  vendor: canmodule
  full_name: USB CANFD TRIO (can-module.com)
  socs:
    - name: stm32g473xx
```

## zephyr/canmodule/usbcanfd_dual_can_module/board.yml
```yaml
board:
  name: usbcanfd_dual_can_module
  full_name: USB CANFD DUAL (can-module.com)
  vendor: st
  socs:
    - name: stm32g473xx
```

## zephyr/canmodule/usbcanfd_solo_can_module/board.yml
```yaml
board:
  name: usbcanfd_solo_can_module
  full_name: USB CANFD SOLO (can-module.com)
  vendor: st
  socs:
    - name: stm32g431xx
```
